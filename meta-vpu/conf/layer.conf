## meta-vpu/conf/layer.conf
```bitbake
# We have a conf and classes directory, add to BBPATH
BBPATH .= ":${LAYERDIR}"

# We have recipes-* directories, add to BBFILES
BBFILES += "${LAYERDIR}/recipes-*/*/*.bb \
            ${LAYERDIR}/recipes-*/*/*.bbappend"

BBFILE_COLLECTIONS += "meta-vpu"
BBFILE_PATTERN_meta-vpu = "^${LAYERDIR}/"
BBFILE_PRIORITY_meta-vpu = "6"

LAYERDEPENDS_meta-vpu = "core"
LAYERSERIES_COMPAT_meta-vpu = "scarthgap"
```
